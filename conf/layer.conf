## conf/layer.conf
```bitbake
# We have a conf and classes directory, add to BBPATH
BBPATH .= ":${LAYERDIR}"
# We have recipes-* directories add to bbfiles
BBFILES += "${LAYERDIR}/recipes-*/*/*.bb \
	    ${LAYERDIR}/recipes-*/*/*.bbappend"

BBFILE_COLLECTIONS += "meta-zondax-stm32mp"
BBFILE_PATTERN_meta-zondax-stm32mp = "^${LAYERDIR}/"
BBFILE_PRIORITY_meta-zondax-stm32mp = "6"

LAYERSERIES_COMPAT_meta-zondax-stm32mp = "honister"
XSERVER ?= " \
    xserver-xorg \
    xserver-xorg-module-libint10 \
    xf86-input-evdev \
    xf86-video-modesetting \
"
MACHINE_FEATURES:append += " x11"
DISTRO_FEATURES:append= " x11"
EXTRA_IMAGE_FEATURES:append = " x11 debug-tweaks "

# Mask the broken bbappend from the parent layer
BBMASK = "meta-st-stm32mp/recipes-graphics/drm/libdrm_2.4.107.bbappend"
```

## conf/machine/stm32mp1-disco-basic.conf
```bitbake
#@TYPE: Machine
#@NAME: stm32mp1-disco-basic
#@DESCRIPTION: STM32MP157F-DK2 board with OP-TEE
#@NEEDED_BSPLAYERS: layers/meta-openembedded/meta-oe layers/meta-openembedded/meta-python

require stm32mp1-disco-zondax.inc
```

## conf/machine/stm32mp1-disco-secure.conf
```bitbake
#@TYPE: Machine
#@NAME: stm32mp1-disco-secure
#@DESCRIPTION: STM32MP157F-DK2 board with OP-TEE and Secure boot
#@NEEDED_BSPLAYERS: layers/meta-openembedded/meta-oe layers/meta-openembedded/meta-python

require secure-boot.inc
require stm32mp1-disco-zondax.inc
```
